## board/ulevb/mx6ulevb6/Kconfig
```kconfig
if TARGET_MX6ULEVB6

config SYS_BOARD
	default "mx6ulevb6"

config SYS_VENDOR
	default "ulevb"

config SYS_CONFIG_NAME
	default "mx6ulevb6"

endif
```

## board/ulevb/ulevb6/Kconfig
```kconfig
if TARGET_ULEVB6

config SYS_BOARD
	default "ulevb6"

config SYS_VENDOR
    default "ulevb"

config SYS_CONFIG_NAME
	default "ulevb6"

endif
```
